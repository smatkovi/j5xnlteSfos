## msm8916_sec_j5xnlte_eur_defconfig
```kconfig
CONFIG_SEC_J5X_PROJECT=y
CONFIG_MACH_J5XLTE_EUR_OPEN=y

CONFIG_RESTART_REASON_SEC_PARAM=y

# SS Pinctrl Driver
CONFIG_SEC_GPIO_SETTINGS=y

# MUIC
CONFIG_SM5703_MUIC=y
CONFIG_USBID_STANDARD_VER_01=y
CONFIG_MUIC_SUPPORT_CHARGING_CABLE=y
CONFIG_MUIC_SUPPORT_RUSTPROOF=y
CONFIG_MUIC_SUPPORT_DESKDOCK=y

#USB Host
CONFIG_USB_HOST_NOTIFY=y

#Touch Screen
CONFIG_TOUCHSCREEN_IST30XXC_CMCS=y
#CONFIG_TOUCHSCREEN_ZINITIX_BT541=y
CONFIG_TOUCHSCREEN_TA_CALLBACK_ENABLE=y

#Touchkey
CONFIG_KEYBOARD_TC360_TKEY_J5X=y
CONFIG_KEYBOARD_TC305_TKEY=y
CONFIG_TOUCHKEY_GRIP=y

# Vibrator
#CONFIG_MSM_VIBRATOR is not set
CONFIG_SM5703_VIBRATOR=y

#LCD
CONFIG_PANEL_S6E8AA5X01_AMS520KT01_HD=y
CONFIG_SAMSUNG_DEBUG_DISPLAY=n

#SENSOR
CONFIG_SENSORS=y
CONFIG_SENSORS_CORE=y
CONFIG_SENSORS_K2HH=y
CONFIG_SENSORS_CM36672P=y
CONFIG_SENSORS_CM36672P_SMART_PERS=y
CONFIG_SENSORS_SX9310=y

#NFC
CONFIG_NFC=y
CONFIG_NFC_PN547=y
CONFIG_NFC_PN547_8916_USE_BBCLK2=y
CONFIG_NFC_PN547_8916_CLK_CTL=y
CONFIG_NFC_PN547_PVDD_EN_CONTROL=y

#FLASH
CONFIG_FLASHLIGHT=y
CONFIG_SM_FLASH_LED=y
CONFIG_FLED_SM5703=y
CONFIG_FLED_SM5703_EXT_GPIO=y
#CONFIG_FLED_LM3632 is not set
CONFIG_FLED_KTD2692=y
CONFIG_FRONT_FLASH=y

#CAMERA
CONFIG_S5K3L2XX=y
CONFIG_S5K5E3YX=y
CONFIG_SR552=y
CONFIG_CAMERA_SYSFS_V2=y
CONFIG_SW_LANDING_FOR_MULTI_TASKING=y
CONFIG_MSM_FRONT_EEPROM=y
CONFIG_MSM_OTP=y

#HALL IC
CONFIG_SENSORS_HALL=y

#AUDIO
CONFIG_RADIO_IRIS=y
CONFIG_RADIO_IRIS_TRANSPORT=y

#optimize mmc block delay on resume
CONFIG_MMC_BLOCK_DEFERRED_RESUME=y

# Pre-power on alarm
# CONFIG_RTC_AUTO_PWRON is not set
# CONFIG_RTC_AUTO_PWRON_PARAM is not set

# IPSec
CONFIG_CRYPTO_NULL=y

# Charging/Battery
CONFIG_MFD_SM5703=y
CONFIG_REGULATOR_SM5703=y
CONFIG_CHARGER_SM5703=y
CONFIG_BATTERY_SAMSUNG=y
CONFIG_BATTERY_SAMSUNG_DATA_FILE="j5x_battery_data.h"
CONFIG_SAMSUNG_LPM_MODE=y
CONFIG_FUELGAUGE_SM5703=y
CONFIG_BATTERY_SWELLING=y
CONFIG_SIOP_CHARGING_LIMIT_CURRENT=700
CONFIG_PREVENT_SOC_JUMP=y
CONFIG_SW_SELF_DISCHARGING=y
CONFIG_CHARGER_SM5703_DUALPATH=y

# DUAL SIM / SINGLE SIM Detection
CONFIG_CHECK_SIMSLOT_COUNT=y
# CONFIG_CHECK_SIMSLOT_COUNT_GPIO is not set
CONFIG_CHECK_SIMSLOT_COUNT_DT=y

# SSWAP
CONFIG_SWAP=y
CONFIG_FRONTSWAP=y
CONFIG_ZSMALLOC=y
CONFIG_ZSWAP=y
CONFIG_QUOTACTL=y
CONFIG_DEVTMPFS_MOUNT=y
CONFIG_DUMMY=n
CONFIG_QUOTA_NETLINK_INTERFACE=y
CONFIG_IKCONFIG=y
CONFIG_PROC_FS=y
CONFIG_IKCONFIG_PROC=y
CONFIG_VT=y
CONFIG_FHANDLE=y
CONFIG_SYSVIPC=y
CONFIG_QUOTA=y
CONFIG_DEVTMPFS=y
#
CONFIG_TMPFS_POSIX_ACL=y
CONFIG_QFMT_V2=y
CONFIG_SYSFS=y
CONFIG_EXPERT=y
CONFIG_MULTIUSER=y
CONFIG_SECURITY=y
CONFIG_SECURITY_NETWORK=y
CONFIG_AUDIT=y
CONFIG_NET=y
CONFIG_INET=y
CONFIG_SECURITY_SELINUX=y
CONFIG_MODULES=y
CONFIG_SECURITY_YAMA=y
CONFIG_SECURITY_YAMA_STACKED=y


CONFIG_NETFILTER=y

CONFIG_NETFILTER_ADVANCED=y
CONFIG_NETFILTER_XT_MATCH_DCCP=y
CONFIG_NF_CONNTRACK=y
CONFIG_NF_NAT=y
CONFIG_NETFILTER_XT_NAT=y


CONFIG_BTRFS_FS=y
CONFIG_CUSE=y
CONFIG_UDF_FS=y
CONFIG_IP6_NF_MATCH_FRAG=y

CONFIG_RESOURCE_COUNTERS=y
CONFIG_CGROUP_MEM_RES_CTLR=y
CONFIG_CGROUP_MEM_RES_CTLR_SWAP=y
CONFIG_EXPERIMENTAL=y
#CONFIG_BT_HCIVHCI=y
CONFIG_IP6_NF_MATCH_AH=y
CONFIG_AUTOFS4_FS=y
#CONFIG_RTC_DRV_CMOS=y
##CONFIG_BT_BNEP_PROTO_FILTER=y
##
#CONFIG_CPU_CK860=y
#CONFIG_SMP=y
##CONFIG_CPUSETS=y
#CONFIG_CGROUP_PERF=y
##CONFIG_BT_RFCOMM=y
#CONFIG_CHECKPOINT_RESTORE=y
#CONFIG_CIFS=y
#CONFIG_NET_CLS_CGROUP=y
##CONFIG_BT_HCIUART=y
#CONFIG_WATCHDOG=y
#CONFIG_WATCHDOG_NOWAYOUT=y
#
##CONFIG_BT_HCIUART_H4=y
#CONFIG_FW_LOADER=y
#CONFIG_FW_LOADER_USER_HELPER=y
#CONFIG_FW_LOADER_USER_HELPER_FALLBACK=y
#CONFIG_RFKILL=y
##CONFIG_BT_BNEP_MC_FILTER=y
#CONFIG_RESOURCE_COUNTERS=y
#CONFIG_CGROUP_MEM_RES_CTLR=y
#CONFIG_CGROUP_MEM_RES_CTLR_KMEM=y
#CONFIG_BLK_CGROUP=y
##
##CONFIG_NETFILTER_XT_MATCH_RECENT=y
##CONFIG_ISO9660_FS=y
##CONFIG_IPC_NS=y
##
##CONFIG_NETFILTER_XT_MATCH_NFACCT=y
##CONFIG_PID_NS=y
##CONFIG_NETPRIO_CGROUP=y
##CONFIG_NETFILTER_XT_MATCH_SCTP=y
##
##CONFIG_FANOTIFY=y
##CONFIG_UTS_NS=y
#CONFIG_CGROUP_DEVICE=y
##CONFIG_NETFILTER_NETLINK_ACCT=y
##CONFIG_BT_HIDP=y
##CONFIG_BT_BNEP=y
#CONFIG_IP6_NF_MATCH_MH=y
```
